//##################################################################################################################
//##################################################################################################################
//##                                      FFT N=256  Integer                                                      ##
//##                                    [K]=X[N] \ E^2PI*K*n/N                                                    ##
//##                                f/s = 5 Khz   Niquist = 2.5 Khz                                               ##
//##                          1x FFT-Calculation = 52ms  > ca. 20/second                                          ##
//##################################################################################################################
//##################################################################################################################
#include <avr/pgmspace.h>
#include <TimerOne.h>
#include <UTFT.h>

// Declare Colors
#define BLACK   0x0000
#define BLUE    0x001F
#define RED     0xF800
#define GREEN   0x07E0
#define CYAN    0x07FF
#define MAGENTA 0xF81F
#define YELLOW  0xFFE0
#define WHITE   0xFFFF
#define ORANGE  0xFBE0
#define GRAY    0x7BEF

// Set the pins to the correct ones for your development shield
// ------------------------------------------------------------
// Arduino Mega:
// Standard Arduino Mega/Due shield            : <display model>,38,39,40,41
// CTE TFT LCD/SD Shield for Arduino Mega      : <display model>,38,39,40,41
//
// Remember to change the model parameter to suit your display module!
UTFT tft(SSD1289, 38, 39, 40, 41);

#define microseconds_1 200  //Timer1 in mikro seconds  default =100 =8,32 khz / 200=4.995 khz
//-----------------------------------------------------------------------------------------
int const re_wn[128] PROGMEM = {                                                     //reelle Wn Values  (Cos)
  256  , 256  , 256  , 255  , 255  , 254  , 253  , 252  , 251  , 250  , 248  , 247  , 245  , 243  , 241  , 239 ,
  237  , 234  , 231  , 229  , 226  , 223  , 220  , 216  , 213  , 209  , 206  , 202  , 198  , 194  , 190  , 185 ,
  181  , 177  , 172  , 167  , 162  , 157  , 152  , 147  , 142  , 137  , 132  , 126  , 121  , 115  , 109  , 104 ,
  98  , 92  , 86  , 80  , 74  , 68  , 62  , 56  , 50  , 44  , 38  , 31  , 25  , 19  , 13  , 6 ,
  0  , -6  , -13  , -19  , -25  , -31  , -38  , -44  , -50  , -56  , -62  , -68  , -74  , -80  , -86  , -92,
  - 98  , -104  , -109  , -115  , -121  , -126  , -132  , -137  , -142  , -147  , -152  , -157  , -162  , -167  , -172  , -177,
  - 181  , -185  , -190  , -194  , -198  , -202  , -206  , -209  , -213  , -216  , -220  , -223  , -226  , -229  , -231  , -234 ,
  - 237  , -239  , -241  , -243  , -245  , -247  , -248  , -250  , -251  , -252  , -253  , -254  , -255  , -255  , -256  , -256
};
int const im_wn[128] PROGMEM = {                                                     //imaginäre Wn Values  (Sin)
  0  , -6  , -13  , -19  , -25  , -31  , -38  , -44  , -50  , -56  , -62  , -68  , -74  , -80  , -86  , -92,
  - 98  , -104  , -109  , -115  , -121  , -126  , -132  , -137  , -142  , -147  , -152  , -157  , -162  , -167  , -172  , -177,
  - 181  , -185  , -190  , -194  , -198  , -202  , -206  , -209  , -213  , -216  , -220  , -223  , -226  , -229  , -231  , -234,
  - 237  , -239  , -241  , -243  , -245  , -247  , -248  , -250  , -251  , -252  , -253  , -254  , -255  , -255  , -256  , -256,
  - 256  , -256  , -256  , -255  , -255  , -254  , -253  , -252  , -251  , -250  , -248  , -247  , -245  , -243  , -241  , -239,
  - 237  , -234  , -231  , -229  , -226  , -223  , -220  , -216  , -213  , -209  , -206  , -202  , -198  , -194  , -190  , -185,
  - 181  , -177  , -172  , -167  , -162  , -157  , -152  , -147  , -142  , -137  , -132  , -126  , -121  , -115  , -109  , -104,
  - 98  , -92  , -86  , -80  , -74  , -68  , -62  , -56  , -50  , -44  , -38  , -31  , -25  , -19  , -13  , -6
};
//------------------------------------------------------------------------------------------------------------------
//256 Points Dft shared in 128*2 Points Dft
//1.Dft =0/64  2.=32/96  etc.              K = 0-N/2
//------------------------------------------------------------------------------------------------------------------
byte const dft[2500] PROGMEM = {
  0 , 128 , 64 , 192 , 32 , 160 , 96 , 224 , 16 , 144 , 80 , 208 , 48 , 176 , 112 , 240 ,      //start adr.0 Dec
  8 , 136 , 72 , 200 , 40 , 168 , 104 , 232 , 24 , 152 , 88 , 216 , 56 , 184 , 120 , 248 ,
  4 , 132 , 68 , 196 , 36 , 164 , 100 , 228 , 20 , 148 , 84 , 212 , 52 , 180 , 116 , 244,
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  15 , 143 , 79 , 207 , 47 , 175 , 111 , 239 , 31 , 159 , 95 , 223 , 63 , 191 , 127 , 255,
  //------------------------------------------------------------------------------------------------------------------
  0 , 64 , 128 , 192 , 32 , 96 , 160 , 224 , 16 , 80 , 144 , 208 , 48 , 112 , 176 , 240  ,     //start adr.256 Dec
  8 , 72 , 136 , 200 , 40 , 104 , 168 , 232 , 24 , 88 , 152 , 216 , 56 , 120 , 184 , 248,
  4 , 68 , 132 , 196 , 36 , 100 , 164 , 228 , 20 , 84 , 148 , 212 , 52 , 116 , 180 , 244,
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  15 , 79 , 143 , 207 , 47 , 111 , 175 , 239 , 31 , 95 , 159 , 223 , 63 , 127 , 191 , 255,
  //-------------------------------------------------------------------------------------------------------------------
  0 , 32 , 128 , 160 , 64 , 96 , 192 , 224 , 16 , 48 , 144 , 176 , 80 , 112 , 208 , 240   ,    //start adr.512 Dec
  8 , 40 , 136 , 168 , 72 , 104 , 200 , 232 , 24 , 56 , 152 , 184 , 88 , 120 , 216 , 248,
  4 , 36 , 132 , 164 , 68 , 100 , 196 , 228 , 20 , 52 , 148 , 180 , 84 , 116 , 212 , 244,
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  15 , 47 , 143 , 175 , 79 , 111 , 207 , 239 , 31 , 63 , 159 , 191 , 95 , 127 , 223 , 255,
  //-------------------------------------------------------------------------------------------------------------------
  0 , 16 , 128 , 144 , 64 , 80 , 192 , 208 , 32 , 48 , 160 , 176 , 96 , 112 , 224 , 240  ,     //start adr.768 Dec
  8 , 24 , 136 , 152 , 72 , 88 , 200 , 216 , 40 , 56 , 168 , 184 , 104 , 120 , 232 , 248,
  4 , 20 , 132 , 148 , 68 , 84 , 196 , 212 , 36 , 52 , 164 , 180 , 100 , 116 , 228 , 244,
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  15 , 31 , 143 , 159 , 79 , 95 , 207 , 223 , 47 , 63 , 175 , 191 , 111 , 127 , 239 , 255,
  //-------------------------------------------------------------------------------------------------------------------
  0 , 8 , 128 , 136 , 64 , 72 , 192 , 200 , 32 , 40 , 160 , 168 , 96 , 104 , 224 , 232,       //start adr.1024 Dec
  16 , 24 , 144 , 152 , 80 , 88 , 208 , 216 , 48 , 56 , 176 , 184 , 112 , 120 , 240 , 248,
  4 , 12 , 132 , 140 , 68 , 76 , 196 , 204 , 36 , 44 , 164 , 172 , 100 , 108 , 228 , 236,
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  23 , 31 , 151 , 159 , 87 , 95 , 215 , 223 , 55 , 63 , 183 , 191 , 119 , 127 , 247 , 255,
  //-------------------------------------------------------------------------------------------------------------------
  0 , 4 , 128 , 132 , 64 , 68 , 192 , 196 , 32 , 36 , 160 , 164 , 96 , 100 , 224 , 228  ,     //start adr.1280 Dec
  16 , 20 , 144 , 148 , 80 , 84 , 208 , 212 , 48 , 52 , 176 , 180 , 112 , 116 , 240 , 244,
  8 , 12 , 136 , 140 , 72 , 76 , 200 , 204 , 40 , 44 , 168 , 172 , 104 , 108 , 232 , 236,
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  27 , 31 , 155 , 159 , 91 , 95 , 219 , 223 , 59 , 63 , 187 , 191 , 123 , 127 , 251 , 255,
  //-------------------------------------------------------------------------------------------------------------------
  0 , 2 , 128 , 130 , 64 , 66 , 192 , 194 , 32 , 34 , 160 , 162 , 96 , 98 , 224 , 226 ,      //start adr.1536 Dec
  16 , 18 , 144 , 146 , 80 , 82 , 208 , 210 , 48 , 50 , 176 , 178 , 112 , 114 , 240 , 242,
  8 , 10 , 136 , 138 , 72 , 74 , 200 , 202 , 40 , 42 , 168 , 170 , 104 , 106 , 232 , 234,
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  29 , 31 , 157 , 159 , 93 , 95 , 221 , 223 , 61 , 63 , 189 , 191 , 125 , 127 , 253 , 255,
  //-------------------------------------------------------------------------------------------------------------------
  0 , 1 , 128 , 129 , 64 , 65 , 192 , 193 , 32 , 33 , 160 , 161 , 96 , 97 , 224 , 225 ,      //start adr.1792 Dec
  16 , 17 , 144 , 145 , 80 , 81 , 208 , 209 , 48 , 49 , 176 , 177 , 112 , 113 , 240 , 241,
  8 , 9 , 136 , 137 , 72 , 73 , 200 , 201 , 40 , 41 , 168 , 169 , 104 , 105 , 232 , 233,
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  30 , 31 , 158 , 159 , 94 , 95 , 222 , 223 , 62 , 63 , 190 , 191 , 126 , 127 , 254 , 255,
  //-------------------------------------------------------------------------------------------------------------------
  //wn_table[288] //Wn                                                                       //start Adr:   2048=800hex
  0 , 64 , 0 , 0 , 0 , 0 , 0 , 0 , 0 , 0 , 0 , 0 , 0 , 0 , 0 , 0   ,                         //Dec  2048
  0 , 32 , 64 , 96 , 0 , 0 , 0 , 0 , 0 , 0 , 0 , 0 , 0 , 0 , 0 , 0  ,                        //Dec  2064
  0 , 16 , 32 , 48 , 64 , 80 , 96 , 112 , 0 , 0 , 0 , 0 , 0 , 0 , 0 , 0,                     //Dec  2080
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  112 , 113 , 114 , 115 , 116 , 117 , 118 , 119 , 120 , 121 , 122 , 123 , 124 , 125 , 126 , 127
};
//-------------------------------------------------------------------------------------------------------------------

int A[256];                             //Sample array
int Ak[256];                            //Reell array
int Bk[256];                            //Imaginär array
byte P[128];                            //Frequency Spectrum output

byte t;
byte y;
byte x;
byte w;
int z;
int s;
int u;
int v;

int zw1;
int zw2;
int zw3;
int zw4;
int zw5;
int zw6;
int zw7;
int zw8;

#define led 13
#define controll_pin 12
#define analog_pin 0
boolean led_status = false;
int counter = 0;
//-----------------------------------------------------------------------------------------
void setup() {

  pinMode(led, OUTPUT);
  pinMode(controll_pin, OUTPUT);
  pinMode(analog_pin, INPUT);

  // Setup the LCD
  tft.InitLCD();//(oriantation:90)
  tft.clrScr();
  tft.setBackColor(BLACK);

  Serial.begin(9600);

  check();
  //load_sinus();
  //load_rectangle();
  //load_triangle();
  //load_zero();
  //  fft();
  //  koeffizienten();
  //  output_display();
  // output_terminal();

  Timer1.initialize(microseconds_1);
  Timer1.attachInterrupt(timer1_subroutine);
}
//-----------------------------------------------------------------------------------------
void loop() {

  fft();
  koeffizienten();
  output_display();
  if (led_status == true) {
    led_status = false;
    digitalWrite(led, HIGH); //  Toggle led
  }
  else {
    led_status = true;
    digitalWrite(led, LOW);
  }
}
//-----------------------------------------------------------------------------------------
void check() {                                                 //EEprom check

  zw1 = 0;
  for (int i = 0 ; i < 256; i++) {                             //32640 Checksumme
    zw1 += pgm_read_byte_near(dft + (i + 1792));
    //Serial.print(String(pgm_read_byte_near(dft + (i+1792))) + ",");
  }
  Serial.print(String(zw1));
  if (zw1 == 32640) Serial.println(" > EEprom Check OK");
  if (zw1 != 32640) Serial.println(" > EEprom Check Failed");
}
//-----------------------------------------------------------------------------------------
void load_sinus() {                                              //Test-Sinus

  float pi_2 = 6.28 / 256;
  for (int i = 0 ; i < 256; i++) {
    A[i] = int(sin(pi_2 * i) * 50);
    //Serial.println(String(A[i]));
  }
  Serial.println("Sinus loaded");
}
//-----------------------------------------------------------------------------------------
void load_zero() {                                              //Test-Zero line

  for (int i = 0 ; i < 256; i++) {
    A[i] = 50;
    //Serial.println(String(A[i]));
  }
  Serial.println("Zero Line loaded");
}
//-----------------------------------------------------------------------------------------
void load_rectangle() {                                         //Test-Rectangle line

  for (int i = 0 ; i < 128; i++) {
    A[i] = 50;
    //Serial.println(String(A[i]));
  }
  for (int i = 128 ; i < 256; i++) {
    A[i] = -50;
    //Serial.println(String(A[i]));
  }
  Serial.println("Rectangle loaded");
}
//---------------------------------------------------------------------------------------- -
void load_triangle() {                                          //Test-Rectangle line

  for (int i = 0 ; i < 64; i++) {
    A[i] = i;
    //Serial.println(String(A[i]));
  }
  for (int i = 64 ; i < 128; i++) {
    A[i] = 128 - i;
    //Serial.println(String(A[i]));
  }
  for (int i = 128 ; i < 192; i++) {
    A[i] = (128 - i);
    //Serial.println(String(A[i]));
  }
  for (int i = 192 ; i < 256; i++) {
    A[i] = i - 256;
    //Serial.println(String(A[i]));
  }
  Serial.println("Triangle loaded");
}
//-----------------------------------------------------------------------------------------
void division_zw1_256() {
  //zw1 = zw1 / 256;
  zw1 = zw1 >> 8;
}
//-----------------------------------------------------------------------------------------
void division_zw2_256() {
  //zw2 = zw2 / 256;
  zw2 = zw2 >> 8;
}
//-----------------------------------------------------------------------------------------
void division_zw3_256() {
  //zw3 = zw3 / 256;
  zw3 = zw3 >> 8;
}
//-----------------------------------------------------------------------------------------
void division_zw4_256() {
  //zw4 = zw4 / 256;
  zw4 = zw4 >> 8;
}
//-----------------------------------------------------------------------------------------
void division_zw1_2() {
  //zw1 = zw1 / 2;
  zw1 = zw1 >> 1;
}
//-----------------------------------------------------------------------------------------
void division_zw2_2() {
  //zw2 = zw2 / 2;
  zw2 = zw2 >> 1;
}
//-----------------------------------------------------------------------------------------
void division_zw3_2() {
  //zw3 = zw3 / 2;
  zw3 = zw3 >> 1;
}
//-----------------------------------------------------------------------------------------
void fft() {                                                //FFT

  z = 0;
  do {
    x = pgm_read_byte_near(dft + z);
    zw1 = A[x];
    z++;
    y = pgm_read_byte_near(dft + z);                         //2.Punkte DFT
    zw2 = A[y];
    z++;
    //-------------------
    zw3 = zw1 + zw2;                                         //1.Rücksortierung
    division_zw3_2();                                        //zw3 = zw3 / 2
    Ak[x] = zw3;
    Bk[x] = 0;
    zw3 = zw1 - zw2;
    division_zw3_2()  ;                                      //zw3 = zw3 / 2
    Ak[y] = zw3;
    Bk[y] = 0;
  } while (z < 256);

  //-----------------
  z = 256;                                                   //2. Rücksortierung
  v = 2048;
  t = 2;                                                     //2 mal W4^0-W4^1
  s = 2050;
  transformation();
  //-----------------
  z = 512;                                                   //3. Rücksortierung
  v = 2064;
  t = 4;                                                     //4 mal W8^0-W8^3
  s = 2068;
  transformation();
  //-----------------
  z = 768;                                                   //4. Rücksortierung
  v = 2080;
  t = 8;                                                     //8 mal W16^0-W16^7
  s = 2088;
  transformation();
  //-----------------
  z = 1024;                                                  //5. Rücksortierung
  v = 2096;
  t = 16;                                                    //16 mal  W32^0-W32^15
  s = 2112;
  transformation();
  //-----------------
  z = 1280;                                                  //6. Rücksortierung
  v = 2112;
  t = 32;                                                    //32 mal  W64^0-W64^31
  s = 2144;
  transformation();
  //-----------------
  z = 1536 ;                                                 //7. Rücksortierung
  v = 2144;
  t = 64;                                                    //64 mal W128^0-W128^63
  s = 2208;
  transformation();
  //-----------------
  z = 1792;                                                  //8. Rücksortierung
  v = 2208;
  t = 128;                                                   //128 mal W256^0-W256^127
  s = 2336;
  transformation();
}
//-----------------------------------------------------------------------------------------
void transformation() {
  //                                                         //1.EEprom Address for the Butterfly array
  //                                                         //loop for 128 Butterflys
  for (int u = 0; u < 128; u++) {

    x = pgm_read_byte_near(dft + z);
    z++;                                                     //next EEpromaddress
    y = pgm_read_byte_near(dft + z);
    z++;                                                     //next EEpromaddress

    w = pgm_read_byte_near(dft + v);                         //1.Wn Factor is ever Wn^0 and located at address Re[0] und Im[0]
    zw1 = Ak[y] * pgm_read_word_near(re_wn + w);
    division_zw1_256();                                      //zw1=zw1/256
    zw2 = Bk[y] * pgm_read_word_near(im_wn + w);
    division_zw2_256();                                      //zw2 = zw2 / 256
    zw3 = Ak[y] * pgm_read_word_near(im_wn + w);
    division_zw3_256();                                      //zw3 = zw3 / 256
    zw4 = Bk[y] * pgm_read_word_near(re_wn + w);
    division_zw4_256();                                      //zw4 = zw4 / 256

    zw5 = zw1 - zw2;                                         //zw5 = Ak[y]
    zw6 = zw3 + zw4;                                         //zw6 = Bk[y]
    zw7 = Ak[x];                                             //zw7 = Ak[x]
    zw8 = Bk[x];                                             //zw8 = Bk[x]

    //copy back to Ak[x] and Bk[x] , Ak[y] and Bk[y],
    zw1 = zw7 + zw5;                                         //Butterfly Operations
    division_zw1_2();
    Ak[x] = zw1;

    zw2 = zw8 + zw6;
    division_zw2_2();
    Bk[x] = zw2;

    zw3 = zw7 - zw5;
    division_zw3_2();
    Ak[y] = zw3;

    zw3 = zw8 - zw6;
    division_zw3_2();
    Bk[y] = zw3;

    v++;                                                    //next Wn value
    if ( v = s ) v = s - t;
  }
}
//-----------------------------------------------------------------------------------------
void koeffizienten() {

  for (int i = 0 ; i < 128; i++) {
    x = pgm_read_byte_near(dft + i);
    zw1 = Ak[x];
    zw2 = Bk[x];
    zw1 = abs(zw1);                                            //quick Pythagoras :-)
    zw2 = abs(zw2);
    if (zw1 < zw2) {
      zw2 = zw2 + zw2;
    }
    else {
      zw1 = zw1 + zw1;
    }
    zw3 = zw1 + zw2;
    P[i] = zw3;
  }
}
//-----------------------------------------------------------------------------------------
void output_terminal() {

  for (int i = 0 ; i < 128; i++) {
    Serial.println(String(P[i]) + ",");
  }
}
//-----------------------------------------------------------------------------------------
void output_display() {

  byte val;
  for (int i = 0 ; i < 128; i++) {
    val =  P[i];
    if ( val > 128) val = 128;
    tft.setColor(BLACK);
    tft.drawLine(i, 0, i, 128);
    tft.setColor(WHITE);
    tft.drawLine(i, 0, i, val);
  }
}
//-----------------------------------------------------------------------------------------
void timer1_subroutine(void) {

  digitalWrite(controll_pin, HIGH); //measure the Sample frequenz
  digitalWrite(controll_pin, LOW);
  A[counter] = analogRead(analog_pin) - 512;  // read the input pin - 512
  counter++;
  if (counter > 255) counter = 0;
}
